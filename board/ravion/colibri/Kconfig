## board/ravion/colibri/Kconfig
```kconfig
if TARGET_RAVION_COLIBRI_IMX6

config SYS_BOARD
	default "colibri"

config SYS_CONFIG_NAME
	default "ravion_colibri_imx6"

config SYS_CPU
	default "armv7"

config SYS_SOC
	default "mx6"

config SYS_VENDOR
	default "ravion"

config RAVION_DISPLAY_KOE
	default y

config RAVION_CFG_BLOCK
	default y

config RAVION_HAVE_MMC
	default y

config RAVION_CFG_BLOCK_DEV
	default "0"

config RAVION_CFG_BLOCK_PART
	default "1"

# Toradex config block in eMMC, at the end of 1st "boot sector"
config RAVION_CFG_BLOCK_OFFSET
	default "-512"

config RAVION_CMD_IMX_MFGR
	bool "Enable factory testing commands for Toradex iMX 6 modules"
	help
	  This adds the commands
	    pf0100_otp_prog - Program the OTP fuses on the PMIC PF0100
	  If executed on already fused modules it doesn't change any fuse setting.
	default y

source "board/ravion/common/Kconfig"

endif
```

## board/ravion/imx8mq_rhos/Kconfig
```kconfig
if TARGET_IMX8MQ_RHOS

config SYS_BOARD
	default "imx8mq_rhos"

config SYS_VENDOR
	default "ravion"

config SYS_CONFIG_NAME
	default "imx8mq_rhos"

source "board/ravion/common/Kconfig"

endif
```

## board/ravion/mx511utsvu/Kconfig
```kconfig
if TARGET_MX511UTSVU

config SYS_BOARD
	default "mx511utsvu"

config SYS_VENDOR
	default "ravion"

config SYS_SOC
	default "mx5"

config SYS_CONFIG_NAME
	default "mx511utsvu"

endif
```

## board/ravion/ravion/Kconfig
```kconfig
if TARGET_RAVION_IMX6

config SYS_BOARD
	default "ravion"

config SYS_CONFIG_NAME
	default "ravion_imx6"

config SYS_CPU
	default "armv7"

config SYS_SOC
	default "mx6"

config SYS_VENDOR
	default "ravion"

config RAVION_CFG_BLOCK
	default y

config RAVION_HAVE_MMC
	default y

config RAVION_CFG_BLOCK_DEV
	default "0"

config RAVION_CFG_BLOCK_PART
	default "1"

# Ravion config block in eMMC, at the end of 1st "boot sector"
config RAVION_CFG_BLOCK_OFFSET
	default "-512"

source "board/ravion/common/Kconfig"

endif
```

## board/ravion/rhos-rk3568j/Kconfig
```kconfig
if TARGET_RHOS_RK3568

config SYS_BOARD
	default "rhos-rk3568j"

config SYS_VENDOR
	default "ravion"

config SYS_CONFIG_NAME
	default "rhos_rk3568"

config BOARD_SPECIFIC_OPTIONS # dummy
	def_bool y

config RAVION_CFG_BLOCK
	default y

config RAVION_HAVE_MMC
	default y

config RAVION_CFG_BLOCK_DEV
	default "0"

config RAVION_CFG_BLOCK_PART
	default "1"

# Ravion config block in eMMC, at the end of 1st "boot sector"
config RAVION_CFG_BLOCK_OFFSET
	default "-512"

source "board/ravion/common/Kconfig"
endif
```

## board/ravion/rhos/Kconfig
```kconfig
if TARGET_IMX8MQ_RHOS

config SYS_BOARD
	default "rhos"

config SYS_SOC
	default "imx8mq"

config SYS_VENDOR
	default "ravion"

config SYS_CONFIG_NAME
	default "imx8mq_rhos"

config IMX_CONFIG
	default "arch/arm/mach-imx/imx8m/imximage.cfg"

config RAVION_CFG_BLOCK
	default y

config RAVION_HAVE_MMC
	default y

config RAVION_CFG_BLOCK_DEV
	default "0"

config RAVION_CFG_BLOCK_PART
	default "1"

# Ravion config block in eMMC, at the end of 1st "boot sector"
config RAVION_CFG_BLOCK_OFFSET
	default "-512"

source "board/ravion/common/Kconfig"

endif
```

## board/toradex/apalis-tk1/Kconfig
```kconfig
if TARGET_APALIS_TK1

config SYS_BOARD
	default "apalis-tk1"

config SYS_VENDOR
	default "toradex"

config SYS_CONFIG_NAME
	default "apalis-tk1"

config TRDX_CFG_BLOCK
	default y

config TRDX_HAVE_MMC
	default y

config TRDX_CFG_BLOCK_DEV
	default "0"

config TRDX_CFG_BLOCK_PART
	default "1"

# Toradex Configblock in eMMC, at the end of 1st "boot sector"
config TRDX_CFG_BLOCK_OFFSET
	default "-512"

endif
```

## board/toradex/apalis_imx6/Kconfig
```kconfig
if TARGET_APALIS_IMX6

config SYS_BOARD
	default "apalis_imx6"

config SYS_CONFIG_NAME
	default "apalis_imx6"

config SYS_CPU
	default "armv7"

config SYS_SOC
	default "mx6"

config SYS_VENDOR
	default "toradex"

config TRDX_CFG_BLOCK
	default y

config TRDX_HAVE_MMC
	default y

config TRDX_CFG_BLOCK_DEV
	default "0"

config TRDX_CFG_BLOCK_PART
	default "1"

# Toradex Configblock in eMMC, at the end of 1st "boot sector"
config TRDX_CFG_BLOCK_OFFSET
	default "-512"

menuconfig TRDX_CMD_IMX_MFGR
	bool "Enable factory testing commands for Toradex iMX 6 modules"
	help
	  This adds the commands
	    mfgr_fuse: OTP fusing during module production
	    pf0100_otp_prog- Program the OTP fuses on the PMIC PF0100
	  If executed on already fused modules they don't change any fuse setting.
	default y

endif
```

## board/toradex/colibri_imx7/Kconfig
```kconfig
if TARGET_COLIBRI_IMX7

config SYS_BOARD
	default "colibri_imx7"

config SYS_VENDOR
	default "toradex"

config SYS_SOC
	default "mx7"

config SYS_CONFIG_NAME
	default "colibri_imx7"

config TRDX_CFG_BLOCK
	default y

config TRDX_HAVE_NAND
	default y

config TRDX_CFG_BLOCK_OFFSET
	default "2048"

config TRDX_CFG_BLOCK_OFFSET2
	default "133120"

config TRDX_CFG_BLOCK_2ND_ETHADDR
	default y

menuconfig TRDX_CMD_IMX_MFGR
	bool "Enable factory testing commands for Toradex iMX 7[B modules"
	help
	  This adds the command
	    mfgr_fuse: OTP fusing during module production
	  If executed on already fused modules they don't change any fuse setting.
	default y

endif
```

## board/toradex/colibri_t20/Kconfig
```kconfig
if TARGET_COLIBRI_T20

config SYS_BOARD
	default "colibri_t20"

config SYS_VENDOR
	default "toradex"

config SYS_CONFIG_NAME
	default "colibri_t20"

config TRDX_CFG_BLOCK
	default y

config TRDX_HAVE_NAND
	default y

config TRDX_CFG_BLOCK_OFFSET
	default "3145728"

endif
```

## board/toradex/colibri_t30/Kconfig
```kconfig
if TARGET_COLIBRI_T30

config SYS_BOARD
	default "colibri_t30"

config SYS_VENDOR
	default "toradex"

config SYS_CONFIG_NAME
	default "colibri_t30"

config TRDX_CFG_BLOCK
	default y

config TRDX_HAVE_MMC
	default y

config TRDX_CFG_BLOCK_DEV
	default "0"

config TRDX_CFG_BLOCK_PART
	default "1"

# Toradex Configblock in eMMC, at the end of 1st "boot sector"
config TRDX_CFG_BLOCK_OFFSET
	default "-512"

endif
```

## board/toradex/colibri_vf/Kconfig
```kconfig
if TARGET_COLIBRI_VF

config SYS_CPU
	default "armv7"

config SYS_BOARD
	default "colibri_vf"

config SYS_VENDOR
	default "toradex"

config SYS_SOC
	default "vf610"

config SYS_CONFIG_NAME
	default "colibri_vf"

config TRDX_CFG_BLOCK
	default y

config TRDX_HAVE_NAND
	default y

config TRDX_CFG_BLOCK_OFFSET
	default "2048"

config TRDX_CFG_BLOCK_2ND_ETHADDR
	default y

endif
```

## board/toradex/common/Kconfig
```kconfig
menuconfig TRDX_CFG_BLOCK
	bool "Enable Toradex config block support"
	help
	  The Toradex config block stored production data on the on-module
	  flash device (NAND or eMMC). The area is normally preserved by
	  software and contains the serial number (out of which the MAC
	  address is generated) and the exact module type.

# Helper config to determine the correct default location of the cfg block
config TRDX_HAVE_NAND
	bool

config TRDX_HAVE_MMC
	bool

if TRDX_CFG_BLOCK

choice
	prompt "Toradex config block location"
	depends on TRDX_CFG_BLOCK
	default TRDX_CFG_BLOCK_IS_IN_NAND if TRDX_HAVE_NAND
	default TRDX_CFG_BLOCK_IS_IN_MMC if TRDX_HAVE_MMC
	help
	  Configure the location of the Toradex config block. By default, the
	  factory version of the Toradex config block is on the NAND or eMMC
	  flash device on the module.

config TRDX_CFG_BLOCK_IS_IN_NAND
	bool "Location of the config block is in NAND"

config TRDX_CFG_BLOCK_IS_IN_MMC
	bool "Location of the config block is in eMMC"

endchoice

config TRDX_CFG_BLOCK_DEV
	int "Toradex config block eMMC device ID"
	depends on TRDX_CFG_BLOCK_IS_IN_MMC

config TRDX_CFG_BLOCK_PART
	int "Toradex config block eMMC partition ID"
	depends on TRDX_CFG_BLOCK_IS_IN_MMC

config TRDX_CFG_BLOCK_OFFSET
	int "Toradex config block offset"
	help
	  Specify the byte offset of the Toradex config block within the flash
	  device the config block is stored on.

config TRDX_CFG_BLOCK_OFFSET2
	int "Toradex config block offset, second instance"
	default 0
	help
	  Specify the byte offset of the 2nd instance of the Toradex config block
	  within the flash device the config block is stored on.
	  Set to 0 on modules which have no 2nd instance.

config TRDX_CFG_BLOCK_2ND_ETHADDR
	bool "Set the second ethernet address"
	help
	  For each serial number two Ethernet addresses are available for dual
	  Ethernet carrier boards. This options enables the code to set the
	  second ethernet address as environment variable (eth1addr).

endif
```

## configs/apalis_imx6_defconfig
```kconfig
CONFIG_ARM=y
CONFIG_TARGET_APALIS_IMX6=y
CONFIG_SYS_EXTRA_OPTIONS="IMX_CONFIG=board/toradex/apalis_imx6/apalis_imx6q.cfg,MX6Q,DDR_MB=1024"
CONFIG_SYS_MALLOC_F=y
CONFIG_SYS_MALLOC_F_LEN=0x400
CONFIG_DM=y
CONFIG_DM_THERMAL=y
```

## configs/colibri_imx7_defconfig
```kconfig
CONFIG_ARM=y
CONFIG_TARGET_COLIBRI_IMX7=y
CONFIG_DM=y
CONFIG_SYS_EXTRA_OPTIONS="IMX_CONFIG=board/toradex/colibri_imx7/imximage.cfg,MX7D,SYS_BOOT_NAND,IMX_NAND"
CONFIG_DM_THERMAL=y
```

## configs/ravion_defconfig
```kconfig
CONFIG_ARM=y
CONFIG_ARCH_MX6=y
CONFIG_SYS_TEXT_BASE=0x17800000
CONFIG_SPL_GPIO_SUPPORT=y
CONFIG_SPL_LIBCOMMON_SUPPORT=y
CONFIG_SPL_LIBGENERIC_SUPPORT=y
CONFIG_NR_DRAM_BANKS=1
CONFIG_SYS_MEMTEST_START=0x10000000
CONFIG_SYS_MEMTEST_END=0x7FFFFFFF
CONFIG_ENV_SIZE=0x2000
CONFIG_MX6Q=y
CONFIG_MX6_OCRAM_256KB=y
CONFIG_TARGET_RAVION_IMX6=y
CONFIG_SYS_I2C_MXC_I2C1=y
CONFIG_SYS_I2C_MXC_I2C2=y
CONFIG_SYS_I2C_MXC_I2C3=y
CONFIG_SPL_TEXT_BASE=0x00908000
CONFIG_SPL_MMC_SUPPORT=y
CONFIG_SPL_SERIAL_SUPPORT=y
CONFIG_SPL_SIZE_LIMIT=69632
CONFIG_SPL=y
CONFIG_SPL_FS_FAT=y
CONFIG_SPL_LIBDISK_SUPPORT=y
CONFIG_CMD_HDMIDETECT=y
CONFIG_SPL_PAYLOAD="u-boot-dtb.img"
CONFIG_BUILD_TARGET=""
CONFIG_DEFAULT_DEVICE_TREE="imx6qp-ravion"
CONFIG_AHCI=y
CONFIG_ENV_VARS_UBOOT_CONFIG=y
CONFIG_SUPPORT_RAW_INITRD=y
CONFIG_SYS_EXTRA_OPTIONS="IMX_CONFIG=arch/arm/mach-imx/spl_sd.cfg"
CONFIG_SD_BOOT=y
CONFIG_BOOTDELAY=3
CONFIG_AUTOBOOT_MENU_SHOW=y
CONFIG_USE_PREBOOT=y
CONFIG_DEFAULT_FDT_FILE="imx6qp-ravion-v2-common.dtb"
CONFIG_SYS_CONSOLE_IS_IN_ENV=y
# CONFIG_DISPLAY_BOARDINFO is not set
CONFIG_DISPLAY_BOARDINFO_LATE=y
CONFIG_ANDROID_AB=y
CONFIG_SPL_LEGACY_IMAGE_CRC_CHECK=y
CONFIG_SPL_SEPARATE_BSS=y
# CONFIG_SYS_MMCSD_RAW_MODE_U_BOOT_USE_SECTOR is not set
CONFIG_SPL_CRYPTO_SUPPORT=y
CONFIG_SPL_HASH_SUPPORT=y
CONFIG_SPL_ENV_SUPPORT=y
CONFIG_SPL_FAT_WRITE=y
CONFIG_SPL_I2C_SUPPORT=y
CONFIG_SPL_MMC_WRITE=y
CONFIG_SPL_OS_BOOT=y
CONFIG_SPL_POWER_SUPPORT=y
CONFIG_SPL_POWER_DOMAIN=y
CONFIG_SPL_USB_HOST_SUPPORT=y
CONFIG_SPL_USB_STORAGE=y
CONFIG_SPL_USB_GADGET=y
CONFIG_SPL_USB_SDP_SUPPORT=y
CONFIG_SPL_WATCHDOG_SUPPORT=y
CONFIG_HUSH_PARSER=y
CONFIG_SYS_PROMPT="Ravion-V2 # "
CONFIG_CMD_BOOTZ=y
# CONFIG_BOOTM_NETBSD is not set
# CONFIG_BOOTM_PLAN9 is not set
# CONFIG_BOOTM_RTEMS is not set
# CONFIG_BOOTM_VXWORKS is not set
CONFIG_CMD_BOOTMENU=y
# CONFIG_CMD_ELF is not set
# CONFIG_CMD_GO is not set
# CONFIG_CMD_XIMG is not set
CONFIG_CMD_SPL=y
CONFIG_CMD_SPL_WRITE_SIZE=0x1000
CONFIG_CMD_ASKENV=y
CONFIG_CMD_ERASEENV=y
CONFIG_CMD_NVEDIT_SELECT=y
# CONFIG_CMD_CRC32 is not set
CONFIG_CMD_MEMTEST=y
CONFIG_SYS_ALT_MEMTEST=y
# CONFIG_CMD_FUSE is not set
CONFIG_CMD_GPIO=y
CONFIG_CMD_GPT=y
# CONFIG_RANDOM_UUID is not set
CONFIG_CMD_I2C=y
# CONFIG_CMD_LOADS is not set
CONFIG_CMD_MMC=y
# CONFIG_CMD_MMC_RPMB is not set
CONFIG_CMD_PCI=y
CONFIG_CMD_SATA=y
CONFIG_CMD_USB=y
CONFIG_CMD_USB_MASS_STORAGE=y
CONFIG_CMD_DHCP=y
CONFIG_CMD_MII=y
CONFIG_CMD_PING=y
CONFIG_CMD_CACHE=y
CONFIG_CMD_SYSBOOT=y
CONFIG_CMD_PMIC=y
CONFIG_CMD_REGULATOR=y
CONFIG_CMD_EXT2=y
CONFIG_CMD_EXT4=y
CONFIG_CMD_FAT=y
CONFIG_CMD_FS_GENERIC=y
CONFIG_PARTITION_TYPE_GUID=y
CONFIG_OF_CONTROL=y
CONFIG_SPL_OF_CONTROL=y
CONFIG_OF_SPL_REMOVE_PROPS=""
CONFIG_ENV_IS_IN_FAT=y
CONFIG_ENV_FAT_DEVICE_AND_PART="0:1"
CONFIG_SPL_DM=y
# CONFIG_DM_WARN is not set
# CONFIG_DM_DEVICE_REMOVE is not set
CONFIG_SPL_DM_SEQ_ALIAS=y
CONFIG_REGMAP=y
CONFIG_SPL_REGMAP=y
CONFIG_SYSCON=y
CONFIG_SPL_SYSCON=y
CONFIG_SPL_OF_TRANSLATE=y
CONFIG_DWC_AHSATA=y
# CONFIG_BLOCK_CACHE is not set
CONFIG_BUTTON=y
CONFIG_BUTTON_GPIO=y
CONFIG_L2X0_CACHE=y
CONFIG_SPL_CLK_COMPOSITE_CCF=y
CONFIG_CLK_COMPOSITE_CCF=y
CONFIG_SPL_CLK_IMX6Q=y
CONFIG_CLK_IMX6Q=y
CONFIG_USB_FUNCTION_FASTBOOT=y
CONFIG_UDP_FUNCTION_FASTBOOT=y
CONFIG_FASTBOOT_BUF_ADDR=0x12000000
CONFIG_GPIO_HOG=y
CONFIG_SYS_I2C_MXC=y
CONFIG_LED=y
CONFIG_LED_BLINK=y
CONFIG_LED_GPIO=y
CONFIG_MISC=y
CONFIG_SPL_MISC=y
CONFIG_SUPPORT_EMMC_RPMB=y
CONFIG_SUPPORT_EMMC_BOOT=y
CONFIG_MMC_IO_VOLTAGE=y
CONFIG_SPL_MMC_IO_VOLTAGE=y
CONFIG_MMC_UHS_SUPPORT=y
CONFIG_SPL_MMC_UHS_SUPPORT=y
CONFIG_MMC_HS400_ES_SUPPORT=y
CONFIG_SPL_MMC_HS400_ES_SUPPORT=y
CONFIG_MMC_HS400_SUPPORT=y
CONFIG_SPL_MMC_HS400_SUPPORT=y
CONFIG_FSL_USDHC=y
CONFIG_PHYLIB=y
CONFIG_PHY_MICREL=y
CONFIG_PHY_MICREL_KSZ8XXX=y
CONFIG_DM_MDIO=y
CONFIG_FEC_MXC=y
CONFIG_MII=y
CONFIG_PCI=y
CONFIG_DM_PCI=y
CONFIG_DM_PCI_COMPAT=y
CONFIG_PINCTRL=y
CONFIG_PINCONF=y
CONFIG_SPL_PINCTRL=y
CONFIG_SPL_PINCONF=y
CONFIG_PINCTRL_IMX6=y
CONFIG_POWER_DOMAIN=y
CONFIG_DM_PMIC_PFUZE100=y
CONFIG_SPL_DM_PMIC_PFUZE100=y
CONFIG_SPL_DM_REGULATOR=y
CONFIG_DM_REGULATOR_PFUZE100=y
CONFIG_DM_REGULATOR_FIXED=y
CONFIG_SPL_DM_REGULATOR_FIXED=y
CONFIG_DM_REGULATOR_GPIO=y
CONFIG_SPL_DM_REGULATOR_GPIO=y
# CONFIG_SPL_DM_SERIAL is not set
CONFIG_MXC_UART=y
CONFIG_IMX_THERMAL=y
CONFIG_USB=y
CONFIG_USB_STORAGE=y
CONFIG_USB_KEYBOARD=y
CONFIG_USB_KEYBOARD_FN_KEYS=y
CONFIG_USB_GADGET=y
CONFIG_USB_GADGET_MANUFACTURER="FSL"
CONFIG_USB_GADGET_VENDOR_NUM=0x0525
CONFIG_USB_GADGET_PRODUCT_NUM=0xa4a5
CONFIG_CI_UDC=y
CONFIG_SDP_LOADADDR=0x17800000
CONFIG_USB_FUNCTION_SDP=y
# CONFIG_SPL_WDT is not set
# CONFIG_GZIP is not set
CONFIG_ERRNO_STR=y
# CONFIG_EFI_LOADER is not set
```

## configs/ravion_mx511_defconfig
```kconfig
CONFIG_ARM=y
CONFIG_ARCH_MX5=y
CONFIG_SYS_TEXT_BASE=0x97800000
CONFIG_NR_DRAM_BANKS=1
CONFIG_SYS_MEMTEST_START=0x90010000
CONFIG_SYS_MEMTEST_END=0xaf500000
CONFIG_ENV_SIZE=0x2000
CONFIG_ENV_OFFSET=0xC0000
CONFIG_TARGET_MX511UTSVU=y
CONFIG_DM_GPIO=y
# CONFIG_CMD_BMODE is not set
CONFIG_DEFAULT_DEVICE_TREE="imx51-ravion-utsvu"
CONFIG_SYS_EXTRA_OPTIONS="IMX_CONFIG=board/ravion/mx511utsvu/imximage.cfg"
CONFIG_USE_PREBOOT=y
CONFIG_SYS_CONSOLE_IS_IN_ENV=y
CONFIG_SYS_CONSOLE_OVERWRITE_ROUTINE=y
CONFIG_SPL_SPI_FLASH_MTD=y
CONFIG_HUSH_PARSER=y
CONFIG_CMD_BOOTZ=y
CONFIG_CMD_MEMTEST=y
CONFIG_SYS_ALT_MEMTEST=y
CONFIG_CMD_DM=y
CONFIG_CMD_MMC=y
# CONFIG_CMD_PINMUX is not set
CONFIG_CMD_SPI=y
CONFIG_CMD_USB=y
# CONFIG_CMD_SETEXPR is not set
CONFIG_CMD_DHCP=y
CONFIG_CMD_MII=y
CONFIG_CMD_PING=y
# CONFIG_CMD_DATE is not set
CONFIG_CMD_FAT=y
CONFIG_OF_CONTROL=y
CONFIG_ENV_OVERWRITE=y
CONFIG_ENV_IS_IN_MMC=y
CONFIG_SYS_RELOC_GD_ENV_ADDR=y
CONFIG_DM=y
CONFIG_BUTTON=y
CONFIG_BUTTON_GPIO=y
CONFIG_L2X0_CACHE=y
CONFIG_GPIO_HOG=y
CONFIG_DM_GPIO_LOOKUP_LABEL=y
CONFIG_DM_I2C=y
CONFIG_SYS_I2C_MXC=y
CONFIG_LED=y
CONFIG_LED_BLINK=y
CONFIG_LED_GPIO=y
CONFIG_DM_MMC=y
CONFIG_FSL_ESDHC_IMX=y
CONFIG_MTD=y
CONFIG_DM_MTD=y
CONFIG_DM_SPI_FLASH=y
# CONFIG_SPI_FLASH_BAR is not set
# CONFIG_SPI_FLASH_UNLOCK_ALL is not set
CONFIG_SPI_FLASH_DATAFLASH=y
CONFIG_SPI_FLASH_MTD=y
CONFIG_MTD_UBI=y
CONFIG_PHYLIB=y
CONFIG_PHY_SMSC=y
CONFIG_PHY_FIXED=y
CONFIG_DM_ETH=y
CONFIG_FEC_MXC=y
CONFIG_MII=y
CONFIG_PINCTRL=y
CONFIG_PINCONF=y
CONFIG_PINCTRL_IMX5=y
CONFIG_DM_PMIC=y
CONFIG_DM_REGULATOR=y
CONFIG_DM_REGULATOR_FIXED=y
CONFIG_SPL_DM_REGULATOR_FIXED=y
CONFIG_DM_REGULATOR_GPIO=y
CONFIG_DM_RTC=y
CONFIG_SPECIFY_CONSOLE_INDEX=y
CONFIG_DM_SERIAL=y
CONFIG_SERIAL_SEARCH_ALL=y
CONFIG_SERIAL_PROBE_ALL=y
CONFIG_MXC_UART=y
CONFIG_SPI=y
CONFIG_DM_SPI=y
CONFIG_FSL_QSPI=y
CONFIG_FSL_QSPI_AHB_FULL_MAP=y
CONFIG_MXC_SPI=y
CONFIG_USB=y
CONFIG_DM_USB=y
CONFIG_USB_EHCI_MX5=y
CONFIG_USB_STORAGE=y
CONFIG_USB_HOST_ETHER=y
CONFIG_USB_ETHER_ASIX=y
CONFIG_USB_ETHER_SMSC95XX=y
CONFIG_SYS_WHITE_ON_BLACK=y
CONFIG_SPLASH_SCREEN=y
```
