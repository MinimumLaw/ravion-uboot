// SPDX-License-Identifier: GPL-2.0+
/*
 * (C) Copyright 2024 Alex A. Mihaylov <minimumlaw@rambler.ru>
 */

#include "rk356x-u-boot.dtsi"

/ {
	chosen {
		stdout-path = &uart2;
	};
};

&sdhci {
	mmc-hs400-enhanced-strobe;
};

&uart2 {
	clock-frequency = <24000000>;
	bootph-all;
	status = "okay";
};
